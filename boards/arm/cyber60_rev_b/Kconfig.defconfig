## boards/arm/cyber60_rev_b/Kconfig.defconfig
```kconfig
# Copyright (c) 2020 Stefan Sundin (4pplet)
# SPDX-License-Identifier: MIT

if BOARD_CYBER60_REV_B

config ZMK_KEYBOARD_NAME
	default "cyber60 Rev B"

if USB

config USB_NRFX
	default y

config USB_DEVICE_STACK
	default y

endif # USB

config BT_CTLR
	default BT

config ZMK_BLE
	default y

config ZMK_USB
	default y
	
config ZMK_BATTERY_VOLTAGE_DIVIDER
	default y

endif # BOARD_CYBER60_REV_B
```

## config/boards/4pplet/cyber60/Kconfig.cyber60
```kconfig
# Cyber60 board configuration

# Copyright (c) 2025 Stefan Sundin (4pplet)
# SPDX-License-Identifier: MIT

config BOARD_CYBER60
    select SOC_NRF52840_QIAA
    imply RETAINED_MEM
    imply RETENTION
    imply RETENTION_BOOT_MODE
```

## config/boards/4pplet/cyber60/Kconfig.defconfig
```kconfig
# Copyright (c) 2025 Stefan Sundin (4pplet)
# SPDX-License-Identifier: MIT

if BOARD_CYBER60

config ZMK_KEYBOARD_NAME
	default "cyber60"

if USB

config USB_NRFX
	default y

config USB_DEVICE_STACK
	default y

config USB_DEVICE_MANUFACTURER
	default "4pplet"

endif # USB

if BT

config BT_DIS_MANUF
	default "4pplet"

config BT_DIS_MODEL
	default "Cyber60"

endif # BT

config BT_CTLR
	default BT

config ZMK_BLE
	default y

config ZMK_USB
	default y

if ZMK_RGB_UNDERGLOW

config ZMK_RGB_UNDERGLOW_HUE_START
	default 0

config ZMK_RGB_UNDERGLOW_EFF_START
	default 0

endif # ZMK_RGB_UNDERGLOW

endif # BOARD_CYBER60
```

## config/boards/4pplet/cyber60/board.yml
```yaml
board:
  name: cyber60
  vendor: 4pplet
  socs:
    - name: nrf52840
  revision:
    format: custom
    default: rev_e
    revisions:
      - name: rev_a
      - name: rev_b
      - name: rev_c
      - name: rev_d
      - name: rev_e
```

## config/boards/4pplet/cyber60/cyber60_rev_a_defconfig
```kconfig
# SPDX-License-Identifier: MIT

CONFIG_MPU_ALLOW_FLASH_WRITE=y
CONFIG_NVS=y
CONFIG_SETTINGS_NVS=y
CONFIG_FLASH=y
CONFIG_FLASH_PAGE_LAYOUT=y
CONFIG_FLASH_MAP=y

# Enable MPU
CONFIG_ARM_MPU=y

# Enable GPIO
CONFIG_GPIO=y

# Build uf2
CONFIG_USE_DT_CODE_PARTITION=y
CONFIG_BUILD_OUTPUT_UF2=y

# Enable sleep, default set to 45 min (defined in ms)
CONFIG_ZMK_SLEEP=y
CONFIG_ZMK_IDLE_SLEEP_TIMEOUT=2700000
```

## config/boards/4pplet/cyber60/cyber60_rev_b_defconfig
```kconfig
# SPDX-License-Identifier: MIT

CONFIG_MPU_ALLOW_FLASH_WRITE=y
CONFIG_NVS=y
CONFIG_SETTINGS_NVS=y
CONFIG_FLASH=y
CONFIG_FLASH_PAGE_LAYOUT=y
CONFIG_FLASH_MAP=y

# Enable MPU
CONFIG_ARM_MPU=y

# Enable GPIO
CONFIG_GPIO=y

# Enable PWM
CONFIG_PWM=y
CONFIG_PWM_NRFX=y

# Enable Underglow
CONFIG_ZMK_RGB_UNDERGLOW=y
CONFIG_ZMK_RGB_UNDERGLOW_EXT_POWER=y
CONFIG_ZMK_RGB_UNDERGLOW_ON_START=n

# Enable the rotary encoder
CONFIG_EC11=y
CONFIG_EC11_TRIGGER_GLOBAL_THREAD=y

# Enable pinctrl
CONFIG_PINCTRL=y

# Build uf2
CONFIG_USE_DT_CODE_PARTITION=y
CONFIG_BUILD_OUTPUT_UF2=y

# Enable ZMK Studio
CONFIG_ZMK_STUDIO=y
CONFIG_ZMK_STUDIO_LOCKING=n

# USB CDC-ACM for ZMK Studio RPC
CONFIG_USB_CDC_ACM=y
CONFIG_SERIAL=y
CONFIG_UART_INTERRUPT_DRIVEN=y
CONFIG_UART_LINE_CTRL=y

# Enable sleep, default set to 45 min (defined in ms)
CONFIG_ZMK_SLEEP=y
CONFIG_ZMK_IDLE_SLEEP_TIMEOUT=2700000
```

## config/boards/4pplet/cyber60/cyber60_rev_e_defconfig
```kconfig
# SPDX-License-Identifier: MIT

CONFIG_MPU_ALLOW_FLASH_WRITE=y
CONFIG_NVS=y
CONFIG_SETTINGS_NVS=y
CONFIG_FLASH=y
CONFIG_FLASH_PAGE_LAYOUT=y
CONFIG_FLASH_MAP=y

# Enable MPU
CONFIG_ARM_MPU=y

# Enable GPIO
CONFIG_GPIO=y

# Enable PWM
CONFIG_PWM=y
CONFIG_PWM_NRFX=y

# Enable Underglow
CONFIG_ZMK_RGB_UNDERGLOW=y
CONFIG_ZMK_RGB_UNDERGLOW_EXT_POWER=y
CONFIG_ZMK_RGB_UNDERGLOW_ON_START=n

# Enable the rotary encoder
CONFIG_EC11=y
CONFIG_EC11_TRIGGER_GLOBAL_THREAD=y

# Enable pinctrl
CONFIG_PINCTRL=y

# Enable I2C
CONFIG_I2C=y
CONFIG_I2C_NRFX=y

# Enable battery monitoring (ZMK)
CONFIG_ZMK_BATTERY=y
CONFIG_ZMK_MAX17048=y

# External RTC
CONFIG_CLOCK_CONTROL_NRF_K32SRC_RC=n
CONFIG_CLOCK_CONTROL_NRF_K32SRC_XTAL=y
CONFIG_CLOCK_CONTROL_NRF_K32SRC_50PPM=y

# Build uf2
CONFIG_USE_DT_CODE_PARTITION=y
CONFIG_BUILD_OUTPUT_UF2=y

# Enable ZMK Studio
CONFIG_ZMK_STUDIO=y
CONFIG_ZMK_STUDIO_LOCKING=n

# USB CDC-ACM for ZMK Studio RPC
CONFIG_USB_CDC_ACM=y
CONFIG_SERIAL=y
CONFIG_UART_INTERRUPT_DRIVEN=y
CONFIG_UART_LINE_CTRL=y

# Enable sleep, default set to 45 min (defined in ms)
CONFIG_ZMK_SLEEP=y
CONFIG_ZMK_IDLE_SLEEP_TIMEOUT=2700000
```

## config/boards/arm/cyber60/Kconfig.board
```kconfig
# cyber60 board configuration

# Copyright (c) 2020-2021 Stefan Sundin (4pplet)
# SPDX-License-Identifier: MIT

config BOARD_CYBER60
	bool "cyber60"
	depends on SOC_NRF52840_QIAA

config BOARD_CYBER60_REVB
	bool "cyber60_reva"
	depends on BOARD_CYBER60

config BOARD_CYBER60_REVC
	bool "cyber60_revb"
	depends on BOARD_CYBER60
```

## config/boards/arm/cyber60/Kconfig.defconfig
```kconfig
# Copyright (c) 2020-2021 Stefan Sundin (4pplet)
# SPDX-License-Identifier: MIT

if BOARD_CYBER60

config ZMK_KEYBOARD_NAME
	default "cyber60"

if USB

config USB_NRFX
	default y

config USB_DEVICE_STACK
	default y

endif # USB

config BT_CTLR
	default BT

config ZMK_BLE
	default y

config ZMK_USB
	default y

config ZMK_BATTERY_VOLTAGE_DIVIDER
	default y

endif # BOARD_CYBER60
```

## config/boards/arm/cyber60_rev_a/cyber60_rev_a_defconfig
```kconfig
# SPDX-License-Identifier: MIT

CONFIG_SOC_SERIES_NRF52X=y
CONFIG_SOC_NRF52840_QIAA=y
CONFIG_BOARD_CYBER60_REV_A=y

# Enable MPU
CONFIG_ARM_MPU=y

# enable GPIO
CONFIG_GPIO=y

CONFIG_USE_DT_CODE_PARTITION=y
CONFIG_BUILD_OUTPUT_UF2=y

CONFIG_MPU_ALLOW_FLASH_WRITE=y
CONFIG_NVS=y
CONFIG_SETTINGS_NVS=y
CONFIG_FLASH=y
CONFIG_FLASH_PAGE_LAYOUT=y
CONFIG_FLASH_MAP=y

# set TX power level
# CONFIG_BT_CTLR_TX_PWR_PLUS_8=y // Recommended if used in a metal enclosure

# Enable sleep
# CONFIG_ZMK_SLEEP=y
# CONFIG_ZMK_IDLE_SLEEP_TIMEOUT=120000

# Turn on logging, and set ZMK logging to debug output
# CONFIG_LOG_PROCESS_THREAD_STARTUP_DELAY_MS=8000
# CONFIG_ZMK_USB_LOGGING=y
```

## config/boards/arm/cyber60_rev_b/Kconfig.board
```kconfig
# cyber60 board configuration

# Copyright (c) 2020 Stefan Sundin (4pplet)
# SPDX-License-Identifier: MIT

config BOARD_CYBER60_REV_B
	bool "cyber60 Rev B"
	depends on SOC_NRF52840_QIAA
```

## config/boards/arm/cyber60_rev_b/cyber60_rev_b_defconfig
```kconfig
# SPDX-License-Identifier: MIT

CONFIG_SOC_SERIES_NRF52X=y
CONFIG_SOC_NRF52840_QIAA=y
CONFIG_BOARD_CYBER60_REV_B=y

# Enable MPU
CONFIG_ARM_MPU=y

# enable GPIO
CONFIG_GPIO=y

CONFIG_USE_DT_CODE_PARTITION=y
CONFIG_BUILD_OUTPUT_UF2=y

# enable pwm
CONFIG_PWM=y
CONFIG_PWM_NRFX=y

CONFIG_MPU_ALLOW_FLASH_WRITE=y
CONFIG_NVS=y
CONFIG_SETTINGS_NVS=y
CONFIG_FLASH=y
CONFIG_FLASH_PAGE_LAYOUT=y
CONFIG_FLASH_MAP=y

# set TX power level
# CONFIG_BT_CTLR_TX_PWR_PLUS_8=y // Recommended if used in a metal enclosure

# Enable Underglow
CONFIG_ZMK_RGB_UNDERGLOW=y
CONFIG_WS2812_STRIP=y
CONFIG_ZMK_RGB_UNDERGLOW_EXT_POWER=y
CONFIG_ZMK_RGB_UNDERGLOW_ON_START=n

# Enable the rotary encoder
CONFIG_EC11=y
CONFIG_EC11_TRIGGER_GLOBAL_THREAD=y

# Enable sleep
CONFIG_ZMK_SLEEP=n
# CONFIG_ZMK_IDLE_SLEEP_TIMEOUT=120000

# enable pinctrl
CONFIG_PINCTRL=y

# Turn on logging, and set ZMK logging to debug output
CONFIG_LOG_PROCESS_THREAD_STARTUP_DELAY_MS=8000
CONFIG_ZMK_USB_LOGGING=y
```

## config/boards/arm/cyber60_rev_c/Kconfig.board
```kconfig
# cyber60 board configuration

# Copyright (c) 2022 Stefan Sundin (4pplet)
# SPDX-License-Identifier: MIT

config BOARD_CYBER60_REV_C
	bool "cyber60 Rev C"
	depends on SOC_NRF52840_QIAA
```

## config/boards/arm/cyber60_rev_d/Kconfig.board
```kconfig
# cyber60 board configuration

# Copyright (c) 2022 Stefan Sundin (4pplet)
# SPDX-License-Identifier: MIT

config BOARD_CYBER60_REV_D
	bool "cyber60 Rev D"
	depends on SOC_NRF52840_QIAA
```

## config/boards/arm/cyber60_rev_e/Kconfig.board
```kconfig
# cyber60 board configuration

# Copyright (c) 2025 Stefan Sundin (4pplet)
# SPDX-License-Identifier: MIT

config BOARD_CYBER60_REV_E
	bool "cyber60 Rev E"
	depends on SOC_NRF52840_QIAA
```

## config/boards/arm/cyber60_rev_e/Kconfig.defconfig
```kconfig
# Copyright (c) 2025 Stefan Sundin (4pplet)
# SPDX-License-Identifier: MIT

if BOARD_CYBER60_REV_E

config ZMK_KEYBOARD_NAME
	default "cyber60 Rev E"

if USB

config USB_NRFX
	default y

config USB_DEVICE_STACK
	default y

endif # USB

config BT_CTLR
	default BT

config ZMK_BLE
	default y

config ZMK_USB
	default y

config I2C
	default y

config ZMK_MAX17048
	default y

endif # BOARD_CYBER60_REV_E
```

## config/dts/bindings/buzzer/pwm-buzzer.yaml
```yaml
# Copyright (c) 2021, Megamind (megamind4089)
# SPDX-License-Identifier: Apache-2.0

description: PWM Buzzer node

compatible: "pwm-buzzer"

properties:
  pwms:
    type: phandle-array
    required: true

  label:
    required: false
    type: string
    description: Human readable string describing the device (used as device_get_binding() argument)
```

## config/west.yml
```yaml
manifest:
  remotes:
    - name: zmkfirmware
      url-base: https://github.com/zmkfirmware
    - name: nicell
      url-base: https://github.com/nicell
    - name: petejohanson
      url-base: https://github.com/petejohanson
    - name: careyk007
      url-base: https://github.com/careyk007
    - name: innovaker
      url-base: https://github.com/innovaker
    - name: okke-formsma
      url-base: https://github.com/okke-formsma
  projects:
    - name: zmk
      remote: zmkfirmware
      revision: main
      import: app/west.yml
  self:
    path: config
```
